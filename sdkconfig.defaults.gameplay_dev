## sdkconfig.defaults.gameplay_dev
```kconfig
# Gameplay profile: DEV — opening HW development without matrix guard.
# Usage: idf.py -D SDKCONFIG_DEFAULTS="sdkconfig.defaults;sdkconfig.defaults.gameplay_dev" build
CONFIG_CHESS_GAMEPLAY_PROFILE_DEV=y
# CONFIG_CHESS_GAMEPLAY_PROFILE_FULL is not set
CONFIG_CHESS_MG_ENABLE=n
CONFIG_CHESS_ER_ENABLE=y
CONFIG_CHESS_ER_LOCK_GAME=y
CONFIG_CHESS_ER_MUTATE_BOARD=y
CONFIG_CHESS_ER_LED_RED_PERSIST=y
CONFIG_CHESS_ER_LED_RED_BLINK=y
CONFIG_CHESS_ER_LED_VALID_BLUE=y
CONFIG_CHESS_MH_ENABLE=y
CONFIG_CHESS_DIAG_UART_ERROR_DETAIL=y
```

## sdkconfig.defaults.gameplay_lite
```kconfig
# Gameplay profile: LITE — no matrix guard, no error lock, minimal LED hints.
# Usage: idf.py -D SDKCONFIG_DEFAULTS="sdkconfig.defaults;sdkconfig.defaults.gameplay_lite" build
CONFIG_CHESS_GAMEPLAY_PROFILE_LITE=y
# CONFIG_CHESS_GAMEPLAY_PROFILE_FULL is not set
CONFIG_CHESS_MG_ENABLE=n
CONFIG_CHESS_ER_ENABLE=y
CONFIG_CHESS_ER_LOCK_GAME=n
CONFIG_CHESS_ER_MUTATE_BOARD=n
CONFIG_CHESS_ER_LED_RED_PERSIST=n
CONFIG_CHESS_ER_LED_RED_BLINK=n
CONFIG_CHESS_ER_LED_VALID_BLUE=n
CONFIG_CHESS_MH_ENABLE=n
CONFIG_CHESS_DIAG_UART_ERROR_DETAIL=n
```
